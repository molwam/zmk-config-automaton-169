## config/boards/shields/automaton169/Kconfig.defconfig
```kconfig
# Copyright (c) 2022 The ZMK Contributors
# SPDX-License-Identifier: MIT

if SHIELD_AUTOMATON169_LEFT

config ZMK_KEYBOARD_NAME
    default "Automaton169"
    
config ZMK_SPLIT_ROLE_CENTRAL
    default y

endif # LEFT

if SHIELD_AUTOMATON169_LEFT || SHIELD_AUTOMATON169_RIGHT

config ZMK_SPLIT
    default y

endif # LEFT RIGHT

config PWM
    default y

config LED_PWM
    default y
```

## config/boards/shields/automaton169/Kconfig.shield
```kconfig
# Copyright (c) 2022 The ZMK Contributors
# SPDX-License-Identifier: MIT

config SHIELD_AUTOMATON169_LEFT
	def_bool $(shields_list_contains,automaton169_left)

config SHIELD_AUTOMATON169_RIGHT
	def_bool $(shields_list_contains,automaton169_right)
```

## config/west.yml
```yaml
manifest:
  remotes:
    - name: zmkfirmware
      url-base: https://github.com/zmkfirmware
    - name: crides
      url-base: https://github.com/crides
  projects:
    - name: zmk
      remote: crides
      revision: led-widgets
      import: app/west.yml
  self:
    path: config
```
